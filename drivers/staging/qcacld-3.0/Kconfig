## drivers/staging/qcacld-3.0/Kconfig
```kconfig
comment "Qualcomm Atheros CLD WLAN module"

config QCA_CLD_WLAN
	tristate "Qualcomm Atheros CLD WLAN module"
	default n
	help
	  Add support for the Qualcomm Atheros CLD WLAN module

if QCA_CLD_WLAN != n

config QCA_CLD_WLAN_PROFILE
	string "Configuration profile for Qualcomm Atheros CLD WLAN module"
	default "default"
	help
	  Specify which configuration profile to be used for building
	  this module.

	  Profiles are located at drivers/staging/qcacld-3.0/configs.

config WLAN_DEBUG_SPAM
	bool "Enable noisy WLAN debug logs (WoW, stats, hex dumps)"
	default y
	help
	  Enable verbose logging from the Wi-Fi driver, including
	  Wake-on-WLAN packet hex dumps, wake reason counters, and
	  frequent STATS dumps. Disable to reduce dmesg spam.

endif # QCA_CLD_WLAN
```
